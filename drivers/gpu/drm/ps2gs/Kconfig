## drivers/gpu/drm/ps2gs/Kconfig
```kconfig
config DRM_PS2GS
	tristate "DRM Support for the Playstation2 Graphics Synthesizer"
	depends on DRM
	select DRM_KMS_HELPER
	select DRM_KMS_CMA_HELPER
	select DRM_GEM_CMA_HELPER
```

## drivers/ps2/Kconfig
```kconfig
#
# Sony Playstation 2 configuration
#

menu "Sony Playstation 2 devices"

config PS2_ETHER_SMAP
	tristate "Support for PS2 SMAP (ethernet)"
	default y
	depends on SONY_PS2
	depends on NET
	help
	   This enables the driver for the network adapter in the fat PS2.

	   If you don't know what to do here, say Y.

endmenu
```
